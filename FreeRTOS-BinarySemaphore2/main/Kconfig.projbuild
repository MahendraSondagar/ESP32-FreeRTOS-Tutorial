## FreeRTOS-BinarySemaphore2/main/Kconfig.projbuild
```kconfig
# put here your custom config value
menu "Example Configuration"
config ESP_WIFI_SSID
    string "WiFi SSID"
    default "myssid"
    help
	SSID (network name) for the example to connect to.

config ESP_WIFI_PASSWORD
    string "WiFi Password"
    default "mypassword"
    help
	WiFi password (WPA or WPA2) for the example to use.

   config BLINK_GPIO
        int "Blink GPIO number"
        range 0 34
        default 13
        help
            GPIO number (IOxx) to blink on and off.
            Some GPIOs are used for other purposes (flash connections, etc.) and cannot be used to blink.
            GPIOs 35-39 are input-only so cannot be used as outputs.
  config USER_SWITCH
         int "User switch number"
         range 0 12
         default 4
         help
             GPIO Number allocated for the user switch as input io
endmenu
```

## FreeRTOS-CountingSemaphore1/main/Kconfig.projbuild
```kconfig
menu "Example Configuration"

    config USER_SWITCH
        int "User defined switch"
        range 0 34
        default 4
        help
            GPIO number (IOxx) to blink on and off.

            Some GPIOs are used for other purposes (flash connections, etc.) and cannot be used to blink.

            GPIOs 35-39 are input-only so cannot be used as outputs.

endmenu
```
